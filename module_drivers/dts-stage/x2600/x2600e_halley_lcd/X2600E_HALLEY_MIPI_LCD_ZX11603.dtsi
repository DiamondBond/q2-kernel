&dpu {
	status = "okay";
	ingenic,disable-rdma-fb = <1>;
	ingenic,rot_angle = <0>;
	/*Defines the init state of composer fb export infomations.*/
	ingenic,layer-exported = <1 1 0 0>;
	ingenic,layer-frames   = <2 2 2 2>;
	ingenic,layer-framesize = <1366 768>, <1366 768>, <320 240>, <320 240>;   /*Max framesize for each layer.*/
/*	ingenic,layer-framesize = <768 1366>, <768 1366>, <320 240>, <320 240>;   Max framesize for each layer.*/
	layer,color_mode	= <6 1 0 0>;					/*src fmt,*/
	layer,src-size       	= <1366 768>, <1366 768>, <320 240>, <240 200>;	/*Layer src size should smaller than framesize*/
/*	layer,src-size       	= <768 1366>, <768 1366>, <320 240>, <240 200>;	Layer src size should smaller than framesize*/
	layer,target-size	= <1366 768>, <1366 768>, <160 240>, <240 200>;	/*Target Size should smaller than src_size.*/
/*	layer,target-size	= <768 1366>, <768 1366>, <160 240>, <240 200>;	Target Size should smaller than src_size.*/
	layer,target-pos	= <0 0>, <0 0>, <340 480>, <100 980>;	/*target pos , the start point of the target panel.*/
	layer,enable		= <1 1 0 0>;					/*layer enabled or disabled.*/
	ingenic,logo-pan-layer	= <0>;						/*on which layer should init logo pan on.*/
	memory-region=<&reserved_memory>;
	lane2_pn_swap;
	lane3_pn_swap;
};

&i2c3 {
    status = "okay";
    clock-frequency = <100000>;
    pinctrl-0 = <&i2c3_pe>;
    timeout = <1000>;
    pinctrl-names = "default";

    lt8911@29{
        status = "okay";
        compatible = "mipi2edp,lt8911";
        reg = <0x29>;
		lt8911,reset-gpio = <&gpe 4 GPIO_ACTIVE_LOW INGENIC_GPIO_NOBIAS>;
		lt8911,lcd_en-gpio = <&gpc 8 GPIO_ACTIVE_LOW INGENIC_GPIO_NOBIAS>;
		lt8911,bl_en-gpio = <&gpc 7 GPIO_ACTIVE_LOW INGENIC_GPIO_NOBIAS>;
		lt8911,pwm-gpio = <&gpc 17 GPIO_ACTIVE_HIGH INGENIC_GPIO_NOBIAS>;
    };
};

