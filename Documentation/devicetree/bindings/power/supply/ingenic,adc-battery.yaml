## Documentation/devicetree/bindings/power/supply/ingenic,adc-battery.yaml
```yaml
#based on adc-battery.yaml

#ingenic x2600 adc-battery

%YAML 1.2
---
$id: http://devicetree.org/schemas/power/supply/ingenic,adc-battery.yaml#
$schema: http://devicetree.org/meta-schemas/core.yaml#

title: ingenic ADC battery

description:
  Basic battery capacity meter, which only reports basic battery data
  via ADC channels and optionally indicate that the battery is full by
  polling a GPIO line.

  The voltage is expected to be measured between the battery terminals
  and mandatory. The optional current/power channel is expected to
  monitor the current/power flowing out of the battery. Last but not
  least the temperature channel is supposed to measure the battery
  temperature.

allOf:
  - $ref: power-supply.yaml#

properties:
  compatible:
    const: ingenic,adc-battery

  charged-gpios:
    description:
      GPIO which signals that the battery is fully charged. The GPIO is
      often provided by charger ICs, that are not software controllable.
    maxItems: 1

  io-channels:
    minItems: 1
    maxItems: 4

  io-channel-names:
    minItems: 1
    items:
      - const: voltage
      - enum: [ current, power, temperature ]
      - enum: [ power, temperature ]
      - const: temperature

  monitored-battery: true

required:
  - compatible
  - io-channels
  - io-channel-names
  - monitored-battery

unevaluatedProperties: false



eixamples:

battery:battery {
        compatible = "generic-battery";
        voltage-min-design-microvolt = <3600000>;
        voltage-max-design-microvolt = <4200000>;
};

generic-adc-battery{
    compatible = "adc-battery";
    status = "okay";
    io-channels = <&sadc 0>, <&sadc 1>, <&sadc 2>;
    io-channel-names = "voltage", "current", "temperature";
    charged-gpios = <&gpe 15 GPIO_ACTIVE_LOW INGENIC_GPIO_NOBIAS>;

    monitored-battery = <&battery>;
};
```

## arch/mips/xburst2/soc-ad100/Kconfig.DT
```kconfig
choice
	prompt "device tree select for AD100 boards"
	depends on SOC_AD100

config DT_AD100_EVB_V10
	bool "ad100 evb v10 board"

config DT_AD102_APUS_V10
	bool "ad102 apus v10 board"

config DT_AD100_MODULE_BASE
	bool "ad100 module base"

endchoice

config DT_AD100_MODULE_BASE_DTS_FILE
	string "dts file for ad100 module driver"
	depends on DT_AD100_MODULE_BASE
	default "ad100_module_base.dts"
	help
		the dts file location is module_drivers/dts-stage/
```

## arch/mips/xburst2/soc-x2000/Kconfig.DT
```kconfig
choice
	prompt "device tree select for X2000 X2100 boards"
	depends on SOC_X2000 || SOC_X2100

config DT_X2000_MODULE_BASE
       bool "x2000 module base"

config DT_HALLEY5_V20
       bool "x2000 halley5_v20"

config DT_HALLEY5_V30
       bool "x2000 halley5_v30"

config DT_ZEBRA
       bool "x2000 zebra"

config DT_KALE_V10
       bool "x2100 kale_v10"

config DT_KALE_V12
       bool "x2100 kale_v12"

config DT_WICOM_X2000_LINPHONE_OUTDOOR
       bool "wicom x2000 linphone_outdoor"

config DT_WICOM_X2000_LINPHONE_INDOOR
       bool "wicom x2000 linphone_indoor"

config DT_X2100_KALE_V12
       bool "x2100_kale_v12 board"

config DT_X2000_HALLEY5_V30
       bool "x2000_halley5_v30 board"

endchoice

config DT_X2000_MODULE_BASE_DTS_FILE
	string "dts file for X2000 module driver"
	depends on DT_X2000_MODULE_BASE
	default "x2000_module_base.dts"
	help
		the dts file location is arch/mips/boot/dts/ingenic/
```

## arch/mips/xburst2/soc-x2500/Kconfig.DT
```kconfig
choice
	prompt "device tree select for X2500 boards"
	default DT_HIPPO_V10
	depends on SOC_X2500

config DT_X2500_MODULE_BASE
	bool "x2500 module base"
config DT_STAGE_X2500_MODULE_BASE
	bool "x2500 module base (dts-stage)"
config DT_GANDER_V10
	bool "x2500 gander_v10"
config DT_DARWIN_V14
	bool "x2500 darwin_v14"
config DT_HIPPO_V10
	bool "x2500 hippo_v10"
config DT_HIPPO_V12
	bool "x2500 hippo_v12"
config DT_X2500_HIPPO_V12
	bool "x2500_hippo_v12 board"

endchoice

config DT_X2500_MODULE_BASE_DTS_FILE
	string "dts file for X2500 module driver"
	depends on DT_X2500_MODULE_BASE
	default "x2500_module_base.dts"
	help
		the dts file location is arch/mips/boot/dts/ingenic/

config DT_X2500_MODULE_BASE_DTS_STAGE_FILE
	string "dts-stage file for X2500 module driver"
	depends on DT_STAGE_X2500_MODULE_BASE
	default "x2500_module_base.dts"
	help
		the dts file location is module_drivers/dts-stage/x2500/
```

## arch/mips/xburst2/soc-x2600/Kconfig.DT
```kconfig
choice
	prompt "device tree select for X26xx boards"
	depends on SOC_X2600

config DT_X2600_MODULE_BASE
	bool "x2600 module base"
config DT_STAGE_X2600_MODULE_BASE
	bool "x2600 module base (dts-stage)"
config DT_X2660_EVB
	bool "x2660 evb board"
config DT_X2600_TUCANA
	bool "x2600 tucana board"
config DT_X2660_HALLEY_V10
	bool "x2660 halley v1.0 board"
config DT_X2660_HALLEY_V11
	bool "x2660 halley v1.1 board"
config DT_X2670_HALLEY_V10
	bool "x2670 halley v1.0 board"
config DT_X2600E_HALLEY_V10
	bool "x2600E halley v1.0 board"
config DT_X2670M_HARE_V10
	bool "x2670m hare v1.0 board"
config DT_X2600_HALLEY_V10
	bool "x2600 halley v1.0 board"
config DT_X2600H_HALLEY7_V10
	bool "x2600H halley7 v1.0 board"
config DT_X2600M_HALLEY7_V10
	bool "x2600M halley7 v1.0 board"
config DT_XBURST2_EXTERNAL_BOARD
	bool "xburst2 external board."
config DT_X2600_HALLEY7_V10
	bool "x2600_halley7_v1.0/v1.1 board"
config DT_X2670_HARE_V10
	bool "x2670_hare board"
endchoice

config DT_X2600_MODULE_BASE_DTS_FILE
	string "dts file for X2600 module driver"
	depends on DT_X2600_MODULE_BASE
	default "x2600_module_base.dts"
	help
		the dts file location is arch/mips/boot/dts/ingenic/

config DT_X2600_MODULE_BASE_DTS_STAGE_FILE
	string "dts-stage file for X2600 module driver"
	depends on DT_STAGE_X2600_MODULE_BASE
	default "x2600_module_base.dts"
	help
		the dts file location is module_drivers/dts-stage/x2600/
```

## drivers/clk/ingenic/Kconfig
```kconfig
config COMMON_CLK_INGENIC_V1
	bool
	depends on MACH_XBURST || MACH_XBURST2
	select MFD_SYSCON
	select INGENIC_CLK_DEBUG_FS

config INGENIC_CLK_DEBUG_FS
	bool
	depends on DEBUG_FS
	help
	  enable ingenic common clock debugfs

config CLK_X1000_V1
	bool "x1000 clk driver"
	depends on SOC_X1000
	select COMMON_CLK_INGENIC_V1
	help
	  build the ingenic x1000 soc clock driver.

config CLK_X1800_V1
	bool
	depends on SOC_X1800
	select COMMON_CLK_INGENIC_V1
	help
	  build the ingenic x1800 soc clock driver.

config CLK_X1021_V1
	bool
	depends on SOC_X1021
	select COMMON_CLK_INGENIC_V1
	help
	  build the ingenic x1021 soc clock driver.

config CLK_X1520_V1
	bool
	depends on SOC_X1520
	select COMMON_CLK_INGENIC_V1
	help
	  build the ingenic x1520 soc clock driver.

config CLK_X1630_V1
	bool
	depends on SOC_X1630
	select COMMON_CLK_INGENIC_V1
	help
	  build the ingenic x1630 soc clock driver.

config CLK_X2000_V1
	bool
	depends on SOC_X2000
	select COMMON_CLK_INGENIC_V1
	help
	  build the ingenic x2000 soc clock driver.
```

## drivers/media/usb/uvc/Kconfig
```kconfig
# SPDX-License-Identifier: GPL-2.0-only
config USB_VIDEO_CLASS
	tristate "USB Video Class (UVC)"
	depends on VIDEO_V4L2
	select VIDEOBUF2_VMALLOC
	help
	  Support for the USB Video Class (UVC).  Currently only video
	  input devices, such as webcams, are supported.

	  For more information see: <http://linux-uvc.berlios.de/>

config UVC_DISABLE_FRAME_DROPPING
	bool "Host UVC does not activly drop frame data"
	depends on USB_VIDEO_CLASS
	default n
	help
	  Avoid actively dropping frame data due to lack of buffer,
	  which will help decode the image content correctly,
	  such as decoding H264 to display.
	  If you want to retain the received frame as much as possible,
	  say Y.

config USB_VIDEO_CLASS_INPUT_EVDEV
	bool "UVC input events device support"
	default y
	depends on USB_VIDEO_CLASS
	depends on USB_VIDEO_CLASS=INPUT || INPUT=y
	help
	  This option makes USB Video Class devices register an input device
	  to report button events.

	  If you are in doubt, say Y.
```

## module_drivers/Kconfig
```kconfig
menu "Ingenic device-drivers Configurations"


config OUTSIDE_DRIVERS_PATH
	string
	default "module_drivers"

source "module_drivers/drivers/Kconfig"
source "module_drivers/sound/soc/ingenic/Kconfig"

config INGENIC_GLOBAL_INFO
	bool "The ingenic GLOBAL_INFO"
	default n
	help
		GLOBAL INFO
endmenu
```

## module_drivers/drivers/char/Kconfig
```kconfig
config INGENIC_CDBUS
	bool "[CDBUS] Ingenic Cdbus Driver"
	default y
	help
		Say Y here if you want to use cdbus communication function.
		when in doubt , Say N here.

config INGENIC_NEMC
	bool "[NEMC] Ingenic Nemc Driver"
	default n
	help
		Say Y here if you want to use cdbus communication function.
		when in doubt , Say N here.

config INGENIC_PWM_AUDIO
	bool "[PWM-AUDIO] Ingenic Pwm Audio Driver"
	depends on PWM_INGENIC_V3
	default n
	help
		Say Y here if you want to use pwm audio function.
		when in doubt , Say N here.

config INGENIC_PWM_SMC
	bool "[PWM-SMC] Ingenic Pwm SMC Driver"
	depends on PWM_INGENIC_V3
	default n
	help
		Say Y here if you want to use pwm scan function.
		when in doubt , Say N here.

config INGENIC_PWM_GEN
	bool "[PWM-GEN] Ingenic Pwm generate Driver"
	depends on  SOC_X2000 && PWM_INGENIC_V2
	default n
	help
		Say Y here if you want to use pwm scan function.
		when in doubt , Say N here.

config INGENIC_PWM_DMA
	bool "[PWM-DMA] Ingenic Pwm Dma Driver"
	depends on PWM_INGENIC_V3
	default n
	help
		Say Y here if you want to use pwm dma function.
		when in doubt , Say N here.
```

## module_drivers/drivers/input/touchscreen/ft8201p_touch/Kconfig
```kconfig
#
# Focaltech Touchscreen driver configuration
#

config FT8201P_TOUCHSCREEN_FTS
    tristate "Focaltech Touchscreen FT8201P"
    depends on I2C && I2C_INGENIC
    default n
    help
      Say Y here if you have Focaltech touch panel.
      If unsure, say N.
```

## module_drivers/drivers/input/touchscreen/gt9xx_touch/Kconfig
```kconfig
#
# Focaltech Touchscreen driver configuration
#
#
menuconfig TOUCHSCREEN_GT9XX
	tristate "GOODIX GT9XC Touchscreen"
	default n
	help
	  Say Y here if you have GOODIX GT9XX Touchscreen.

	  If unsure, say N.

if TOUCHSCREEN_GT9XX

config TOUCHSCREEN_GT9XX_DIRECTORY
    string "gt ts directory name"
    default "gt9xx_touch"
    depends on TOUCHSCREEN_GT9XX

endif
```

## module_drivers/drivers/input/touchscreen/ilitek/Kconfig
```kconfig
menuconfig TOUCHSCREEN_ILITEK
      tristate "ilitek TouchScreen driver"
      depends on I2C
      default n
      help
        ILITEK TouchScreen driver.

if TOUCHSCREEN_ILITEK
config ILITEK_BOOT_UPDATE
	bool "ILITEK_BOOT_UPDATE"
	default n
	help
	Say Y here if you have tpd button.

	If unsure, say N.

endif
```

## module_drivers/drivers/media/platform/ingenic-isp/Kconfig
```kconfig
config VIC_DMA_ROUTE
	bool "vic dma out route enable"
	default y
	depends on VIDEO_INGENIC_ISP

config ISP_MSCALER_DMA_ROUTE
	bool "isp mscaler dma out route enable"
	default y
	depends on VIDEO_INGENIC_ISP

menuconfig DUMP_FEATURE
	bool "Enable csi/vic/isp/mscaler dump feature"
	default y
	depends on VIDEO_INGENIC_ISP
	help
		Enable this option to generate sysfs attributes for csi/vic/isp/mscaler dump.

config CSI_DUMP
	bool "Enable csi dump feature"
	default y
	depends on DUMP_FEATURE
	help
		Enable this option to generate sysfs attributes for csi dump.

config VIC_DUMP
	bool "Enable vic dump feature"
	default y
	depends on DUMP_FEATURE
	help
		Enable this option to generate sysfs attributes for vic dump.

config ISP_DUMP
	bool "Enable isp dump feature"
	default y
	depends on DUMP_FEATURE
	depends on ISP_MSCALER_DMA_ROUTE
	help
		Enable this option to generate sysfs attributes for isp dump.

config MSCA_DUMP
	bool "Enable mscaler dump feature"
	default y
	depends on DUMP_FEATURE
	depends on ISP_MSCALER_DMA_ROUTE
	help
		Enable this option to generate sysfs attributes for mscaler dump.

#config MSCA_BDEV
#	bool "mscaler bdev support"
#	default n
#	depends on ISP_MSCALER_DMA_ROUTE

# halley5 board
menuconfig HALLEY5_CAMERA_BOARD
	bool "halley5_camera_board"
	depends on VIDEO_INGENIC_ISP
	default n
	help
	  Say Y here to enable support for halley5_camera_boards.

config RD_X2000_HALLEY5_CAMERA_1V0
	bool "halley5 camera driver for RD_X2000_HALLEY5_CAMERA_1V0"
	depends on HALLEY5_CAMERA_BOARD
	select INGENIC_ISP_CAMERA_AR0144
	select INGENIC_ISP_CAMERA_AR0234

config RD_X2000_HALLEY5_CAMERA_2V1
	bool "halley5 camera driver for RD_X2000_HALLEY5_CAMERA_2V1"
	depends on HALLEY5_CAMERA_BOARD
	select INGENIC_ISP_CAMERA_OV2735B
	select INGENIC_ISP_CAMERA_OV2735A

config RD_X2000_HALLEY5_CAMERA_4V2
	bool "halley5 camera driver for RD_X2000_HALLEY5_CAMERA_4V2"
	depends on HALLEY5_CAMERA_BOARD
	select INGENIC_ISP_CAMERA_OV2735B
	select INGENIC_ISP_CAMERA_OV2735A

config RD_X2000_HALLEY5_CAMERA_4V3
	bool "halley5 camera driver for RD_X2000_HALLEY5_CAMERA_4V3"
	depends on HALLEY5_CAMERA_BOARD
	select INGENIC_ISP_CAMERA_OV2735A
	select V4L2_FWNODE

config RD_X2000_HALLEY5_CAMERA_6V0
	bool "halley5 camera driver for RD_X2000_HALLEY5_CAMERA_6V0"
	depends on HALLEY5_CAMERA_BOARD
	select INGENIC_ISP_CAMERA_SC230AI
	select V4L2_FWNODE

config RD_X2000_HALLEY5_CAMERA_3V2
	bool "halley5 camera driver for RD_X2000_HALLEY5_CAMERA_3V2"
	depends on HALLEY5_CAMERA_BOARD
	select INGENIC_ISP_CAMERA_OV4689

choice
	prompt "ov4689 resolution and frame rate select"
	depends on RD_X2000_HALLEY5_CAMERA_3V2
	default OV4689_1080P_30FPS
	help
	Select ov4689 sensor's resolution and frame rate that driver supported.

config OV4689_1080P_120FPS
	bool "OV4689_1080P_120fps"
	depends on RD_X2000_HALLEY5_CAMERA_3V2 || CAMERA_V10

config OV4689_1080P_30FPS
	bool "OV4689_1080P_30fps"
	depends on RD_X2000_HALLEY5_CAMERA_3V2 || CAMERA_V10

config OV4689_2048X1520_30FPS
	bool "ov4689_2048x1520_30fps"
	depends on RD_X2000_HALLEY5_CAMERA_3V2 || CAMERA_V10
endchoice

config RD_X2000_HALLEY5_CAMERA_5V0
	bool "halley5 camera driver for RD_X2000_HALLEY5_CAMERA_5V0"
	depends on HALLEY5_CAMERA_BOARD
	select INGENIC_ISP_CAMERA_AR0144

config RD_X2000_HALLEY5_CAMERA_7V0
	bool "halley5 camera driver for RD_X2000_HALLEY5_CAMERA_7V0"
	depends on HALLEY5_CAMERA_BOARD
	select INGENIC_ISP_CAMERA_GC2053

config RD_X2500_HIPPO_CAMERA_1V1
	bool "halley5 camera driver for RD_X2500_HIPPO_CAMERA_1V1"
	depends on HALLEY5_CAMERA_BOARD
	select INGENIC_ISP_CAMERA_SC230AI

# gewu board
menuconfig GEWU_CAMERA_BOARD
	bool "gewu_camera_board"
	depends on VIDEO_INGENIC_ISP
	default n
	help
	  Say Y here to enable support for gewu_camera_boards.

config CAMERA_V10
	bool "gewu camera driver for CAMERA_1.0"
	depends on GEWU_CAMERA_BOARD
	select INGENIC_ISP_CAMERA_OV4689

choice
	prompt "ov4689 resolution and frame rate select"
	depends on CAMERA_V10
	default GEWU_OV4689_1080P_30FPS
	help
	Select ov4689 sensor's resolution and frame rate that driver supported.

config GEWU_OV4689_1080P_120FPS
	bool "OV4689_1080P_120fps"
	select OV4689_1080P_120FPS
	depends on CAMERA_V10

config GEWU_OV4689_1080P_30FPS
	bool "OV4689_1080P_30fps"
	select OV4689_1080P_30FPS
	depends on CAMERA_V10

config GEWU_OV4689_2048X1520_30FPS
	bool "ov4689_2048x1520_30fps"
	select OV4689_2048X1520_30FPS
	depends on CAMERA_V10
endchoice
```

## module_drivers/drivers/media/platform/ingenic-jpeg-v4l2/Kconfig
```kconfig
menuconfig INGENIC_JPEG_V4L2
	bool "Ingenic JPEG V4L2 codec support"
	depends on SOC_X2600 || SOC_AD100
	default n
	help
	  Support for Ingenic JPEG operations using V4L2 framework.

if INGENIC_JPEG_V4L2

config INGENIC_JPEG_V4L2_DEC
	tristate "Ingenic JPEG V4L2 decoder"
	default n
	help
	  Support for Ingenic JPEG decoding operations using V4L2 framework.

config INGENIC_JPEG_V4L2_ENC
	tristate "Ingenic JPEG V4L2 encoder"
	default n
	help
	  Support for Ingenic JPEG encoding operations using V4L2 framework.

endif # INGENIC_JPEG_V4L2
```
