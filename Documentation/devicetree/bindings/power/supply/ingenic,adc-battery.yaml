## module_drivers/drivers/misc/bootinfo/Kconfig
```kconfig
# drivers/misc/bootinfo/Kconfig

menuconfig BOOTINFO
    bool "Boot Info Support"
    default n
    help
      Enable support for early boot info parsing.

if BOOTINFO

config BOOTINFO_EARLY_SN
    bool "Enable early SN parsing from cmdline"
    default n
    help
      Parse SN from kernel command line using 'sn=xxx'.

endif
```

## module_drivers/drivers/mtd/devices/Kconfig
```kconfig
config INGENIC_SFC
	tristate "Ingenic series SFC driver"
	depends on MACH_XBURST || MACH_XBURST2
	help
		SFC driver for Ingenic series SoCs

if INGENIC_SFC


 choice
 	prompt "Select Ingenic series SFC driver version"
 	default MTD_INGENIC_SFC_V1
 	help
 	  Select the SFC driver version

 config MTD_INGENIC_SFC_V1
 	bool "Use ingenic sfc driver version 1"
 	depends on INGENIC_SFC

 config MTD_INGENIC_SFC_V2
 	bool "Use ingenic sfc driver version 2"
 	depends on INGENIC_SFC

 endchoice


choice
	prompt "the SFC external memory (nor or nand)"
	help
	  Select the SFC external memory
config MTD_INGENIC_SFC_NORFLASH
	bool "Support ingenic sfc-nor"
	depends on INGENIC_SFC

config MTD_INGENIC_SFC_NANDFLASH
	bool "Support ingenic sfc-nand"
	depends on INGENIC_SFC
	select MTD_NAND
config MTD_INGENIC_SFC_BOTH_NAND_NOR
	bool "Support both nand & nor flash"
	depends on INGENIC_SFC
	select MTD_NAND
 endchoice

config MTD_INGENIC_SFC_CONCAT
	bool "Support ingenic sfc multi-flash concat"
	depends on MTD_INGENIC_SFC_V2
	default n
	help
	  Say Y here to enable multi-flash concat topology support.
	  Single-flash products can leave this disabled.

config MTD_INGENIC_SFC_NOR_CONCAT
	bool "Support ingenic sfc-nor concat"
	depends on MTD_INGENIC_SFC_CONCAT
	depends on MTD_INGENIC_SFC_NORFLASH || MTD_INGENIC_SFC_BOTH_NAND_NOR
	default n

config MTD_INGENIC_SFC_NAND_CONCAT
	bool "Support ingenic sfc-nand concat"
	depends on MTD_INGENIC_SFC_CONCAT
	depends on MTD_INGENIC_SFC_NANDFLASH || MTD_INGENIC_SFC_BOTH_NAND_NOR
	select MTD_NAND
	default n


config INGENIC_SFCNAND_FMW
	bool "ingenic SN and MAC read write support."
	default n
	depends on INGENIC_SFC && MTD_INGENIC_SFC_NANDFLASH
	help
		Say Y here if you want to use sn read write function. when in doubt , Say N here.

config SN_SIZE
	int "SN space size (MB)"
	range 1 5
	default 1
	depends on INGENIC_SFCNAND_FMW

config MAC_SIZE
	int "MAC space size (MB)"
	range 1 5
	default 1
	depends on INGENIC_SFCNAND_FMW

config LICENSE_SIZE
	int "LICENSE space size (MB)"
	range 1 5
	default 1
	depends on INGENIC_SFCNAND_FMW


menuconfig INGENIC_BUILTIN_PARAMS
	bool "Use SPI Nor Flash params built in kernel"
	depends on MTD_INGENIC_SFC_NORFLASH
	default n
	help
		Say Y here to SPI Nor Flash params built in kernel.

config INGENIC_GD25Q127C
	bool "GD25Q127C 0xc84018"
	depends on INGENIC_BUILTIN_PARAMS

config INGENIC_GD25Q256C
	bool "GD25Q256C 0xc84019"
	depends on INGENIC_BUILTIN_PARAMS

config INGENIC_GD25S512MD
	bool "GD25S512MD 0xc84019"
	depends on INGENIC_BUILTIN_PARAMS

menuconfig INGENIC_EXTRA_NOR_INFO_ENABLE
	bool "Use Extra Nor Flash Info"
	depends on MTD_INGENIC_SFC_NORFLASH
	default n
	help
		Say Y here to Enable Extra Nor Flash Info.

config INGENIC_EXTRA_NOR_INFO_OFF
	hex "Extra Nor Info Offset"
	default "0x6000"
	depends on INGENIC_EXTRA_NOR_INFO_ENABLE

endif
```

## module_drivers/drivers/net/wireless/88W8987/Kconfig
```kconfig
config WIRELESS_88W8987
	tristate "nxp 88W8987 SDIO WiFi"
	help
	  Help message of 88W8987
```

## module_drivers/drivers/net/wireless/Kconfig
```kconfig
source "module_drivers/drivers/net/wireless/bcmdhd/Kconfig"
source "module_drivers/drivers/net/wireless/bcmdhd_101_10_591_x/Kconfig"
source "module_drivers/drivers/net/wireless/bl602/Kconfig"
source "module_drivers/drivers/net/wireless/seekwave/Kconfig"
source "module_drivers/drivers/net/wireless/aic8800/Kconfig"
source "module_drivers/drivers/net/wireless/ZT9101/Kconfig"
source "module_drivers/drivers/net/wireless/88W8987/Kconfig"
source "module_drivers/drivers/net/wireless/atbm_wifi6_40M_lite/Kconfig"
#source "module_drivers/drivers/net/wireless/realtek/rtl8723ds/Kconfig"
```

## module_drivers/drivers/net/wireless/ZT9101/Kconfig
```kconfig
config ZT9101_WLAN_SUPPORT
	tristate "ZT9101xV20 wireless Support"
	default n
	help
	  This is support for ZT9101xV20 wireless chip.
```

## module_drivers/drivers/net/wireless/aic8800_usb/Kconfig
```kconfig
config AIC_USB_WLAN_SUPPORT
	bool "AIC usb wireless Support"
	default n
	help
	  This is support for aic usb wireless chip.

if AIC_USB_WLAN_SUPPORT
source "module_drivers/drivers/net/wireless/aic8800_usb/aic8800_fdrv/Kconfig"
source "module_drivers/drivers/net/wireless/aic8800_usb/aic_load_fw/Kconfig"
endif
```

## module_drivers/drivers/net/wireless/seekwave_swt6621s/Kconfig
```kconfig
#seekwave`s wifi bluetooth device driver etc
source "module_drivers/drivers/net/wireless/seekwave_swt6621s/seekwaveplatform_lite/Kconfig"
source "module_drivers/drivers/net/wireless/seekwave_swt6621s/swt6621s_wifi/Kconfig"
source "module_drivers/drivers/net/wireless/seekwave_swt6621s/swtbt4l/Kconfig"
```

## module_drivers/drivers/net/wireless/seekwave_swt6621s/seekwaveplatform_lite/Kconfig
```kconfig
menuconfig SEEKWAVE_SWT6621S_DRIVERS
        bool "SeekWave SWT6621S Platform Drivers For SeekWave Chip"
        default n
        help
        This is support seekwave chip for incard board
        if you want to buildin bsp driver
        please say "y" 
        Thanks.

config SEEKWAVE_PLD_RELEASE
    bool "seekwave Platfrom support chip recoverymode"
    depends on SEEKWAVE_SWT6621S_DRIVERS
    default n

config SKW_NO_CONFIG
    bool "skw no config dts"
    depends on SEEKWAVE_SWT6621S_DRIVERS
    default n

#seekwave`s wifi bluetooth device driver etc
if  SEEKWAVE_SWT6621S_DRIVERS
source "module_drivers/drivers/net/wireless/seekwave_swt6621s/seekwaveplatform_lite/usb/Kconfig"
source "module_drivers/drivers/net/wireless/seekwave_swt6621s/seekwaveplatform_lite/sdio/Kconfig"
source "module_drivers/drivers/net/wireless/seekwave_swt6621s/seekwaveplatform_lite/skwutil/Kconfig"
endif
```
